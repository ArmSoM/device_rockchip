## .chips/rk3576/armsom_sige5_rk3576_ubuntu_gnome_defconfig
```kconfig
# RK_BUILDROOT is not set
# RK_YOCTO is not set
RK_ROOTFS_SYSTEM_UBUNTU=y
RK_ROOTFS_TARGET_GNOME=y
CONFIG_RK_UBUNTU_NUMBER="ubuntu22.04"
RK_ROOTFS_IMAGE="ubuntu-${RK_CHIP}-${RK_ROOTFS_TARGET}-rootfs.img"
# RK_WIFIBT is not set
RK_UBOOT_SPL=y
RK_KERNEL_PREFERRED="6.1"
RK_KERNEL_CFG="armsom_linux_rk3576_defconfig"
RK_KERNEL_DTS_NAME="rk3576-armsom-sige5"
RK_KERNEL_EXTBOOT=y
# RK_RECOVERY is not set
RK_EXTRA_PARTITION_NUM=0
RK_PARAMETER="parameter-extboot.txt"
RK_USE_FIT_IMG=y
RK_PACKAGE_FILE_CUSTOM=y
RK_PACKAGE_FILE="package-file-extboot"
RK_PACKAGE_NAME="armsom-${RK_CHIP}-${RK_UBUNTU_NUMBER}-${RK_ROOTFS_TARGET}-$(date +%Y%m%d)"
```
